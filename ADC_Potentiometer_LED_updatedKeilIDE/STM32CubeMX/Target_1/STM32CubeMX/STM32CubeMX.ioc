# file: STM32CubeMX.ioc
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Mcu.Family=STM32F4
Mcu.Name=STM32F429ZITx
Mcu.Package=LQFP144
NVIC.PriorityGroup=NVIC_PRIORITYGROUP_4
ProjectManager.HeapSize=0x200
ProjectManager.StackSize=0x400
ProjectManager.TargetToolchain=MDK-ARM V5
RCC.AHBFreq_Value=16000000
RCC.APB1Freq_Value=16000000
RCC.APB2Freq_Value=16000000
RCC.CortexFreq_Value=16000000
RCC.HSE_VALUE=25000000
RCC.HSI_VALUE=16000000
RCC.LSE_VALUE=32768
RCC.SYSCLKFreq_VALUE=16000000
RCC.VCOOutputFreq_Value=192000000
board=custom

// file: Src/main.c
/* USER CODE BEGIN Header */
/**
  ******************************************************************************
  * @file           : main.c
  * @brief          : Main program body
  ******************************************************************************
  * @attention
  *
  * Copyright (c) 2024 STMicroelectronics.
  * All rights reserved.
  *
  * This software is licensed under terms that can be found in the LICENSE file
  * in the root directory of this software component.
  * If no LICENSE file comes with this software, it is provided AS-IS.
  *
  ******************************************************************************
  */
/* USER CODE END Header */
#include "main.h"

/* USER CODE BEGIN Includes */
#include <stm32f4xx.h>

/* USER CODE END Includes */

void SystemClock_Config(void);

/* USER CODE BEGIN 0 */
void GPIO_Init(void);
void ADC_Init(void);
void TIM3_PWM_Init(void);
uint16_t ADC_Read(void);
void Set_PWM_Duty(uint16_t duty);

/* USER CODE END 0 */

int main(void)
{

  /* USER CODE BEGIN 1 */
	uint16_t adc_value;
  uint16_t pwm_duty;

  // Initialize GPIO, ADC, and TIM3
  GPIO_Init();
  ADC_Init();
  TIM3_PWM_Init();

  /* USER CODE END 1 */

  /* MCU Configuration--------------------------------------------------------*/

  /* Reset of all peripherals, Initializes the Flash interface and the Systick. */
  HAL_Init();

  /* Configure the system clock */
  SystemClock_Config();

  /* Initialize all configured peripherals */

  /* Infinite loop */
  while (1)
  {
		// Read the ADC value from PB1
        adc_value = ADC_Read();

        // Map ADC value (0–4095) to PWM duty cycle (0–100%)
        pwm_duty = (adc_value * 100) / 4095;

        // Set the PWM duty cycle
        Set_PWM_Duty(pwm_duty);

  }
}

void SystemClock_Config(void)
{
  RCC_OscInitTypeDef RCC_OscInitStruct = {0};
  RCC_ClkInitTypeDef RCC_ClkInitStruct = {0};

  /** Configure the main internal regulator output voltage
  */
  __HAL_RCC_PWR_CLK_ENABLE();
  __HAL_PWR_VOLTAGESCALING_CONFIG(PWR_REGULATOR_VOLTAGE_SCALE3);

  /** Initializes the RCC Oscillators according to the specified parameters
  * in the RCC_OscInitTypeDef structure.
  */
  RCC_OscInitStruct.OscillatorType = RCC_OSCILLATORTYPE_HSI;
  RCC_OscInitStruct.HSIState = RCC_HSI_ON;
  RCC_OscInitStruct.HSICalibrationValue = RCC_HSICALIBRATION_DEFAULT;
  RCC_OscInitStruct.PLL.PLLState = RCC_PLL_NONE;
  if (HAL_RCC_OscConfig(&RCC_OscInitStruct) != HAL_OK)
  {
    Error_Handler();
  }

  /** Initializes the CPU, AHB and APB buses clocks
  */
  RCC_ClkInitStruct.ClockType = RCC_CLOCKTYPE_HCLK|RCC_CLOCKTYPE_SYSCLK
                              |RCC_CLOCKTYPE_PCLK1|RCC_CLOCKTYPE_PCLK2;
  RCC_ClkInitStruct.SYSCLKSource = RCC_SYSCLKSOURCE_HSI;
  RCC_ClkInitStruct.AHBCLKDivider = RCC_SYSCLK_DIV1;
  RCC_ClkInitStruct.APB1CLKDivider = RCC_HCLK_DIV1;
  RCC_ClkInitStruct.APB2CLKDivider = RCC_HCLK_DIV1;

  if (HAL_RCC_ClockConfig(&RCC_ClkInitStruct, FLASH_LATENCY_0) != HAL_OK)
  {
    Error_Handler();
  }
}

/* USER CODE BEGIN 4 */
void GPIO_Init(void) {
    // Enable clocks for GPIOA and GPIOB
    RCC->AHB1ENR |= RCC_AHB1ENR_GPIOAEN | RCC_AHB1ENR_GPIOBEN;

    // Configure PA6 as alternate function (TIM3_CH1)
    GPIOA->MODER |= (2 << (6 * 2)); // Alternate function
    GPIOA->AFR[0] |= (2 << (6 * 4)); // AF2 (TIM3)

    // Configure PB1 as analog mode (ADC1_IN9)
    GPIOB->MODER |= (3 << (1 * 2)); // Analog mode
}

void ADC_Init(void) {
    // Enable ADC1 clock
    RCC->APB2ENR |= RCC_APB2ENR_ADC1EN;

    // Configure ADC1
    ADC1->SQR3 = 9;                 // Set channel 9 (PB1) as first in sequence
    ADC1->SMPR2 |= (7 << (3 * 9));  // Sampling time: 480 cycles
    ADC1->CR2 |= ADC_CR2_ADON;      // Enable ADC1
}

uint16_t ADC_Read(void) {
    // Start conversion
    ADC1->CR2 |= ADC_CR2_SWSTART;

    // Wait for conversion to complete
    while (!(ADC1->SR & ADC_SR_EOC));

    // Return ADC value
    return ADC1->DR;
}

void TIM3_PWM_Init(void) {
    // Enable TIM3 clock
    RCC->APB1ENR |= RCC_APB1ENR_TIM3EN;

    // Configure TIM3 for PWM
    TIM3->PSC = 15;                 // Prescaler to get 1 MHz timer clock (16 MHz / 16)
    TIM3->ARR = 999;                // Auto-reload value for 1 kHz frequency (1 MHz / 1000)
    TIM3->CCR1 = 0;                 // Start with 0% duty cycle
    TIM3->CCMR1 |= (6 << 4);        // PWM mode 1
    TIM3->CCER |= TIM_CCER_CC1E;    // Enable output on channel 1
    TIM3->CR1 |= TIM_CR1_CEN;       // Enable the timer
}

void Set_PWM_Duty(uint16_t duty) {
    // Set CCR1 based on duty cycle percentage
    TIM3->CCR1 = (duty * (TIM3->ARR + 1)) / 100;
}

/* USER CODE END 4 */

void Error_Handler(void)
{
  __disable_irq();
  while (1)
  {
  }
}
